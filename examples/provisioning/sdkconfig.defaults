## examples/provisioning/sdkconfig.defaults
```kconfig
CONFIG_PARTITION_TABLE_SINGLE_APP_LARGE=y

CONFIG_LOG_DEFAULT_LEVEL_DEBUG=y

CONFIG_COMPILER_STACK_CHECK_MODE_NORM=y
CONFIG_COMPILER_STACK_CHECK=y
CONFIG_COMPILER_FLOAT_LIB_FROM_GCCLIB=y
CONFIG_COMPILER_OPTIMIZATION_DEBUG=y
CONFIG_COMPILER_OPTIMIZATION_ASSERTIONS_ENABLE=y

CONFIG_ESP_SYSTEM_USE_FRAME_POINTER=y
CONFIG_ESP_SYSTEM_PANIC_PRINT_REBOOT=y
CONFIG_ESP_SYSTEM_PANIC_REBOOT_DELAY_SECONDS=10
CONFIG_FREERTOS_INTERRUPT_BACKTRACE=y

CONFIG_ESP_SYSTEM_EVENT_TASK_STACK_SIZE=4096

CONFIG_PM_SLEEP_FUNC_IN_IRAM=y

CONFIG_HTTPD_WS_SUPPORT=y

CONFIG_MBEDTLS_HKDF_C=y
```
